## configs/pocketbeagle_defconfig
```kconfig
BR2_arm=y
BR2_cortex_a8=y
BR2_DL_DIR="/buildroot-caches/dl"
BR2_HOST_DIR="/buildroot-caches/host"
BR2_CCACHE=y
BR2_CCACHE_DIR="/buildroot-caches/ccache"
BR2_CCACHE_INITIAL_SETUP="-M 10G"
BR2_GLOBAL_PATCH_DIR="board/beaglebone/patches"
BR2_TOOLCHAIN_EXTERNAL=y
BR2_TOOLCHAIN_EXTERNAL_CUSTOM=y
BR2_TOOLCHAIN_EXTERNAL_PATH="/usr/xcc/arm-cortexa8_neon-linux-gnueabihf"
BR2_TOOLCHAIN_EXTERNAL_CUSTOM_PREFIX="arm-cortexa8_neon-linux-gnueabihf"
BR2_TOOLCHAIN_EXTERNAL_GCC_6=y
BR2_TOOLCHAIN_EXTERNAL_HEADERS_4_9=y
BR2_TOOLCHAIN_EXTERNAL_CUSTOM_GLIBC=y
BR2_TOOLCHAIN_EXTERNAL_CXX=y
BR2_TARGET_GENERIC_ROOT_PASSWD="mixa333"
BR2_TARGET_GENERIC_GETTY_PORT="ttyO0"
BR2_ROOTFS_OVERLAY="board/pocketbeagle/overlay"
BR2_ROOTFS_POST_IMAGE_SCRIPT="board/pocketbeagle/post-image.sh"
BR2_LINUX_KERNEL=y
BR2_LINUX_KERNEL_CUSTOM_GIT=y
BR2_LINUX_KERNEL_CUSTOM_REPO_URL="https://github.com/mixaz/bb.org-linux.git"
BR2_LINUX_KERNEL_CUSTOM_REPO_VERSION="4.14"
BR2_LINUX_KERNEL_USE_CUSTOM_CONFIG=y
BR2_LINUX_KERNEL_CUSTOM_CONFIG_FILE="board/pocketbeagle/linux.config"
BR2_LINUX_KERNEL_DTS_SUPPORT=y
BR2_LINUX_KERNEL_INTREE_DTS_NAME="am335x-pocketbeagle"
BR2_PACKAGE_BUSYBOX_SHOW_OTHERS=y
BR2_PACKAGE_CA_CERTIFICATES=y
BR2_PACKAGE_OPENSSL=y
BR2_PACKAGE_LIBOPENSSL_BIN=y
BR2_PACKAGE_LIBOPENSSL_ENGINES=y
BR2_PACKAGE_OPENCV3=y
BR2_PACKAGE_OPENCV3_LIB_SHAPE=y
BR2_PACKAGE_OPENCV3_LIB_STITCHING=y
BR2_PACKAGE_OPENCV3_LIB_SUPERRES=y
BR2_PACKAGE_OPENCV3_LIB_TS=y
BR2_PACKAGE_OPENCV3_LIB_VIDEOSTAB=y
BR2_PACKAGE_OPENCV3_WITH_TIFF=y
BR2_PACKAGE_LIBCURL=y
BR2_PACKAGE_CURL=y
BR2_PACKAGE_DROPBEAR=y
BR2_PACKAGE_BASH=y
BR2_PACKAGE_CGROUPFS_MOUNT=y
BR2_PACKAGE_DOCKER_ENGINE=y
BR2_PACKAGE_DOCKER_ENGINE_DRIVER_BTRFS=y
BR2_TARGET_ROOTFS_EXT2=y
BR2_TARGET_ROOTFS_EXT2_4=y
BR2_TARGET_ROOTFS_EXT2_SIZE="200M"
BR2_TARGET_UBOOT=y
BR2_TARGET_UBOOT_BUILD_SYSTEM_KCONFIG=y
BR2_TARGET_UBOOT_CUSTOM_VERSION=y
BR2_TARGET_UBOOT_CUSTOM_VERSION_VALUE="2018.01"
BR2_TARGET_UBOOT_PATCH="board/pocketbeagle/patches/u-boot-2018.01"
BR2_TARGET_UBOOT_BOARD_DEFCONFIG="am335x_pocketbeagle"
BR2_TARGET_UBOOT_NEEDS_DTC=y
# BR2_TARGET_UBOOT_FORMAT_BIN is not set
BR2_TARGET_UBOOT_FORMAT_IMG=y
BR2_TARGET_UBOOT_FORMAT_CUSTOM=y
BR2_TARGET_UBOOT_FORMAT_CUSTOM_NAME="spl/u-boot-spl.bin"
BR2_TARGET_UBOOT_SPL=y
BR2_TARGET_UBOOT_SPL_NAME="MLO"
BR2_PACKAGE_HOST_DOSFSTOOLS=y
BR2_PACKAGE_HOST_GENIMAGE=y
BR2_PACKAGE_HOST_MTOOLS=y
```

## package/farrowapp/Config.in
```kconfig
config BR2_PACKAGE_FARROWAPP
	bool "farrowapp"
	select BR2_PACKAGE_OPENCV3
	select BR2_PACKAGE_OPENCV3_LIB_CALIB3D
	select BR2_PACKAGE_OPENCV3_LIB_FEATURES2D
	select BR2_PACKAGE_OPENCV3_LIB_FLANN
	select BR2_PACKAGE_OPENCV3_LIB_HIGHGUI
	select BR2_PACKAGE_OPENCV3_GUI_NONE
	select BR2_PACKAGE_OPENCV3_LIB_IMGCODECS
	select BR2_PACKAGE_OPENCV3_LIB_IMGPROC
	select BR2_PACKAGE_OPENCV3_LIB_ML
	select BR2_PACKAGE_OPENCV3_LIB_OBJDETECT
	select BR2_PACKAGE_OPENCV3_LIB_PHOTO
	select BR2_PACKAGE_OPENCV3_LIB_SHAPE
	select BR2_PACKAGE_OPENCV3_LIB_STITCHING
	select BR2_PACKAGE_OPENCV3_LIB_SUPERRES
	select BR2_PACKAGE_OPENCV3_LIB_SUPERRES
	select BR2_PACKAGE_OPENCV3_LIB_TS
	select BR2_PACKAGE_OPENCV3_LIB_VIDEOIO
	select BR2_PACKAGE_OPENCV3_LIB_VIDEO
	select BR2_PACKAGE_OPENCV3_LIB_VIDEOSTAB
	select BR2_PACKAGE_OPENCV3_WITHOUT_GSTREAMER
	select BR2_PACKAGE_OPENCV3_WITH_TIFF
	select BR2_PACKAGE_TIFF
	select BR2_PACKAGE_TIFF_CCITT
	select BR2_PACKAGE_TIFF_PACKBITS
	select BR2_PACKAGE_TIFF_LZW
	select BR2_PACKAGE_TIFF_THUNDER
	select BR2_PACKAGE_TIFF_NEXT
	select BR2_PACKAGE_TIFF_LOGLUV
	select BR2_PACKAGE_TIFF_MDI
	select BR2_PACKAGE_TIFF_ZLIB
	select BR2_PACKAGE_TIFF_PIXARLOG
	select BR2_PACKAGE_TIFF_JPEG
	select BR2_PACKAGE_TIFF_OLD_JPEG
	select BR2_PACKAGE_TIFF_JBIG
	help
	  FarrowApp userspace app from Take4Apps, depends
	  on OpenCV and LibTiff libraries.
```
